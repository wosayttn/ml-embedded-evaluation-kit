## Kconfig
```kconfig
menu "ml-embedded-evaluation-kit"

    config NU_PKG_USING_MLEVK
        bool "Enable"

    choice
        prompt "Select Use-case"

        config MLEVK_UC_OBJECT_DETECTION
            bool "Object detection"

        config MLEVK_UC_VWW
            bool "Visual Wake Word"

        config MLEVK_UC_IMAGE_CLASS
            bool "Image classification"

        config MLEVK_UC_AD
            bool "Anomaly Detection"

        config MLEVK_UC_ASR
            bool "Automated Speech Recognition"

        config MLEVK_UC_INFERENCE_RUNNER
            bool "Inference runner"

        config MLEVK_UC_KWS
            bool "Keyword spotting"

        config MLEVK_UC_KWS_ASR
            bool "Keyword spotting & Automated Speech Recognition"

        config MLEVK_UC_NOISE_REDUCTION
            bool "Noise Reduction"

    endchoice

endmenu
```
